## arch/arm/configs/msm8226-sec_milletwifi_defconfig
```kconfig
#variant defconfig
CONFIG_MACH_MILLETWIFI_OPEN=y
CONFIG_SEC_MILLET_PROJECT=y
CONFIG_SEC_MILLETWIFI_COMMON=y

#Power Management
CONFIG_SEC_PM=y
CONFIG_SEC_PM_DEBUG=y
CONFIG_SAMSUNG_DEBUG_DISPLAY=y
#CONFIG_FB_MSM_MDSS_SHARP_HD_PANEL=y
CONFIG_FB_MSM_MDSS_SDC_WXGA_PANEL=y
CONFIG_FB_MSM8x26_MDSS_CHECK_LCD_CONNECTION=y
CONFIG_ESD_ERR_FG_RECOVERY=y
CONFIG_FB_MSM_MDSS=y
CONFIG_FB_MSM_MDSS_WRITEBACK=y
CONFIG_BACKLIGHT_LCD_SUPPORT=y
CONFIG_MDNIE_TFT_MSM8X26=y
CONFIG_LCD_CLASS_DEVICE=y
CONFIG_BACKLIGHT_CLASS_DEVICE=y
# CONFIG_BACKLIGHT_GENERIC is not set

#VIBRATOR
#CONFIG_QPNP_VIBRATOR is not set

#TSP
CONFIG_TOUCHSCREEN_MMS252=y
#CONFIG_TOUCHSCREEN_BCMTCH15XXX is not set
#CONFIG_KEYBOARD_CYPRESS_TOUCH is not set

#SENSOR
CONFIG_SENSORS=y
CONFIG_SENSORS_K2HH=y



CONFIG_INPUT_POLLDEV=y
CONFIG_INPUT=y
CONFIG_INPUT_GPIO=y
CONFIG_SENSORS_HALL=y

#CAMERA
CONFIG_MSM_CPP=y
#CONFIG_S5K3H5XA=y
#CONFIG_S5K4H5YB=y
#CONFIG_S5K6A3YX=y
#CONFIG_ISX012=y
CONFIG_SR352=y
CONFIG_SR130PC20=y

#USB
CONFIG_USB_ANDROID_SAMSUNG_COMPOSITE=y
# CONFIG_USB_ANDROID_SAMSUNG_MTP is not set
CONFIG_USB_DUN_SUPPORT=y
CONFIG_USB_ANDROID_SAMSUNG_SIDESYNC=y

#USB Host
CONFIG_USB_HOST_NOTIFY=y
CONFIG_USB_STORAGE_DETECT=y
CONFIG_USB_NET_SMSC75XX=y
CONFIG_USB_NET_SMSC95XX=y

#MUIC
#CONFIG_MFD_MAX77693=y
#CONFIG_USB_SWITCH_MAX77693=y
#CONFIG_REGULATOR_MAX77693=y
#CONFIG_DI_MUIC=n
#CONFIG_MUIC_INIT_DETECT_DELAY=3000
#CONFIG_MUIC_USB_DETECT_DELAY=17000
#CONFIG_USB_SWITCH_TSU6721=y
CONFIG_SM5502_MUIC=y
CONFIG_MUIC_SM5502_SUPPORT_LANHUB_TA=y


# IRDA support
#CONFIG_IR_REMOCON_MC96=y

#Battery charging & BMS
CONFIG_BATTERY_SAMSUNG=y
CONFIG_CHARGER_SMB358=y
CONFIG_BATTERY_BCL=y
CONFIG_QPNP_BMS=y
CONFIG_SAMSUNG_LPM_MODE=y
#BT
no need

# TIMA LOG
CONFIG_ARCH_MSM8226_3G_WIFI=y

#Sec Thermistor
CONFIG_SEC_THERMISTOR=y

#Wifi
no need
#
# Enable Qualcomm Wifi features
#
# CONFIG_MSM_PIL_PRONTO is not set
# CONFIG_WCNSS_CORE is not set
# CONFIG_WCNSS_CORE_PRONTO is not set
# CONFIG_WCNSS_MEM_PRE_ALLOC is not set

#
# Wifi features (Qualcomm)
#
# CONFIG_NET_CORE is not set
# CONFIG_WIRELESS is not set
# CONFIG_WIRELESS_EXT_SYSFS is not set
# CONFIG_WEXT_CORE is not set
# CONFIG_WEXT_PROC is not set
# CONFIG_CFG80211 is not set
# CONFIG_CFG80211_DEFAULT_PS is not set
# CONFIG_CFG80211_ALLOW_RECONNECT is not set
# CONFIG_WLAN is not set
# CONFIG_WIRELESS_EXT is not set
# CONFIG_WEXT_PRIV is not set

# CONFIG_MODULES is not set
# CONFIG_MODULE_UNLOAD is not set
# CONFIG_MODULE_FORCE_UNLOAD is not set
# CONFIG_WCNSS_REGISTER_DUMP_ON_BITE is not set
# CONFIG_WCNSS_IRIS_REGISTER_DUMP is not set

# Earjack
CONFIG_SAMSUNG_JACK=y

# CODEC
CONFIG_SND_SOC_MAX98504=y

# GPIO DVS
#CONFIG_SEC_GPIO_DVS is not set
# DHA Solution
#CONFIG_SEC_DHA_SOL_MAL is not set

# SSWAP
# CONFIG_SWAP is not set
# CONFIG_FRONTSWAP is not set
# CONFIG_ZSMALLOC_NEW is not set
# CONFIG_PGTABLE_MAPPING is not set
# CONFIG_ZSWAP is not set
CONFIG_DIRECT_RECLAIM_FILE_PAGES_ONLY=n
# CONFIG_INCREASE_MAXIMUM_SWAPPINESS is not set
# CONFIG_FIX_INACTIVE_RATIO is not set
# CONFIG_TIGHT_PGDAT_BALANCE is not set
# CONFIG_VNSWAP is not set
# CONFIG_SWAP_ENABLE_READAHEAD is not set
```
